## config/west.yml
```yaml
manifest:
  remotes:
    - name: zmkfirmware
      url-base: https://github.com/zmkfirmware
  projects:
    - name: zmk
      remote: zmkfirmware
      revision: 39a14154a98479b864fba7735717e5147f6c0c14
      import: app/west.yml
  self:
    path: config
```
